## conf/layer.conf
```bitbake
BBPATH =. "${LAYERDIR}:"
BBFILES += "${LAYERDIR}/recipes-*/*/*.bb ${LAYERDIR}/recipes-*/*/*.bbappend"

BBFILE_COLLECTIONS += "meta-redmine"
BBFILE_PATTERN_meta-redmine = "^${LAYERDIR}/"
BBFILE_PRIORITY_meta-redmine = "6"

LAYERSERIES_COMPAT_meta-redmine = "wrynose"
```
